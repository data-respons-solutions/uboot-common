## Kconfig
```kconfig
menuconfig DR_COMMON_CONFIGS
	bool "Data Respons common configs"
	default y

config DR_NVRAM
	depends on DR_COMMON_CONFIGS && DM_SPI_FLASH
	bool "DR NVRAM interface"
	help
	  Read/write variables in nvram
	  
config CMD_DR_NVRAM
	depends on DR_COMMON_CONFIGS && DM_SPI_FLASH
	select DR_NVRAM
	bool "DR NVRAM interface CMD"
	help
	  Command for interface nvram
	  
config CMD_DR_SYSTEM_BOOT
	select DR_NVRAM
	bool "DR linux boot command"
	
config CMD_DR_ANDROID_BOOT
	select ANDROID_AB
	select AVB_VERIFY
	select LIBAVB
	select ANDROID_BOOT_IMAGE
	select AVB_SUPPORT
	select ANDROID_DYNAMIC_PARTITION
	select APPEND_BOOTARGS
	select SUPPORT_RAW_INITRD
	bool "DR android boot command"
  
config SPL_LIBNVRAM
	bool "libnvram for SPL"
 
config DR_NVRAM_BUS
	int "SPI bus for flash"
	default 0
	
config DR_NVRAM_CS
	int "CS for flash"
	default 0
	
config DR_NVRAM_SECTION_A_START
	hex "Section a offset in flash"
	default 0

config DR_NVRAM_SECTION_A_SIZE
	hex "Section a size in flash"
	default 0
	
config DR_NVRAM_SECTION_B_START
	hex "Section b offset in flash"
	default 0

config DR_NVRAM_SECTION_B_SIZE
	hex "Section b size in flash"
	default 0

config DR_PLATFORM_HEADER
	bool "Platform header parser"
	
config SPL_DR_PLATFORM_HEADER
	bool "Platform header parser for SPL"
	
config DR_IMX8M_DDRC
	bool "iMX8M ddrc parser"
	
config SPL_DR_IMX8M_DDRC
	bool "iMX8M ddrc parser for SPL"
```
